## conf/distro/embedded-container-distro.conf
```bitbake
include conf/distro/poky.conf

DISTRO = "embedded-container-distro"

# Append poky based features
DISTRO_FEATURES_append = " virtualization"
DISTRO_FEATURES_append = " systemd"

# Remove unused features
DISTRO_FEATURES_remove = " \
    3g \
    bluetooth \
    bluez5 \
    ipv6 \
    nfc \
    nfs \
    sysvinit \
    wifi \
    wayland \
    zeroconf \
    "

# Use systemd as init manager
VIRTUAL-RUNTIME_init_manager = "systemd"
DISTRO_FEATURES_BACKFILL_CONSIDERED += "sysvinit"
VIRTUAL-RUNTIME_initscripts = ""

# Add these binaries to the HOSTTOOLS_NONFATAL variable to allow them to
# be called from within the recipe build task. They are specified as
# NONFATAL as they are not installed at the same time on the build
# system.
HOSTTOOLS_NONFATAL += "sudo pidof dockerd podman newgidmap newuidmap"
```

## conf/layer.conf
```bitbake
# We have a conf and classes directory, add to BBPATH
BBPATH .= ":${LAYERDIR}"

# We have recipes-* directories, add to BBFILES
BBFILES += "${LAYERDIR}/recipes-*/*/*.bb \
    ${LAYERDIR}/recipes-*/*/*.bbappend"

BBFILE_COLLECTIONS += "embedded-containers"
BBFILE_PATTERN_embedded-containers = "^${LAYERDIR}/"
BBFILE_PRIORITY_embedded-containers = "6"

LAYERSERIES_COMPAT_embedded-containers = "dunfell"

LAYERDEPENDS_embedded-containers = "virtualization-layer"
```
